    tri_layer {
        display-name = "@( * O * )@";
        bindings = <
    //╭──────────┬──────────┬──────────┬──────────┬──────────┬──────────╮   ╭──────────┬──────────┬──────────┬───────────┬──────────┬──────────╮
    //│          │  F1      │  F2      │  F3      │  F4      │ PROFILE 0│   │ PROFILE 2│ DEC BR   │          │   INC BR  │  WINDOWS │          │
        &trans     &kp F1     &kp F2     &kp F3     &kp F4   &bt BT_SEL 0   &bt BT_SEL 2 &kp C_BRI_DEC &none &kp C_BRI_UP  &kp C_AC_DESKTOP_SHOW_ALL_WINDOWS     &trans
    //├──────────┼──────────┼──────────┼──────────┼──────────┼──────────┤   ├──────────┼──────────┼──────────┼───────────┼──────────┼──────────┤
    //│          │  F5      │  F6      │  F7      │  F8      │ PROFILE 1│   │ PROFILE 3│ VOL DOWN │ VOL MUTE │  VOL UP   │  APPS    │          │
        &trans     &kp F5     &kp F6     &kp F7     &kp F8   &bt BT_SEL 1   &bt BT_SEL 3 &kp C_VOL_DN &kp C_MUTE &kp C_VOL_UP &kp C_AC_DESKTOP_SHOW_ALL_APPLICATIONS   &trans
    //├──────────┼──────────┼──────────┼──────────┼──────────┼──────────┤   ├──────────┼──────────┼──────────┼───────────┼──────────┼──────────┤
    //│          │  F9      │  F10     │  F11     │  F12     │  CLEAR BT│   │ PROFILE 4│ PREVSONG │ PLAY PAU |  NEXTSONG │  SEARCH
        &trans     &kp F9     &kp F10    &kp F11    &kp F12    &bt BT_CLR   &bt BT_SEL 4 &kp C_PREV &kp C_PP   &kp C_NEXT &kp C_AC_SEARCH  &trans
    //╰──────────┴──────────┴──────────┴──────────┼──────────┼──────────┤   ├──────────┼──────────┼──────────┴───────────┴──────────┴──────────╯
                                          &trans     &trans     &trans         &trans     &trans     &trans
    //                                 ╰──────────┴──────────┴──────────╯   ╰──────────┴──────────┴──────────╯
        >;
    };
