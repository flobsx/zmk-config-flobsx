    default_layer {
        display-name = "BASE";
        bindings = <
    //╭──────────┬──────────┬──────────┬──────────┬──────────┬──────────╮   ╭──────────┬──────────┬──────────┬──────────┬──────────┬──────────╮
    //│  ESC     │          │          │          │          │          │   │          │          │          │          │          │ BACKSPACE│
            &kp ESC     &trans     &trans     &trans     &trans     &trans         &trans     &trans     &trans     &trans     &trans     &kp BSPC
    //├──────────┼──────────┼──────────┼──────────┼──────────┼──────────┤   ├──────────┼──────────┼──────────┼──────────┼──────────┼──────────┤
    //│  TAB     │          │          │          │          │          │   │          │          │          │          │          │  DELETE  │
            &kp TAB     HRML( A,      S,         D,         F)      &trans         &trans     HRMR( J,      K,         L,    SEMI)     &kp DEL
    //├──────────┼──────────┼──────────┼──────────┼──────────┼──────────┤   ├──────────┼──────────┼──────────┼──────────┼──────────┼──────────┤
    //│          │          │          │          │          │          │   │          │          │          │          │          │          │
            &kp LSHIFT  &trans     &trans     &trans     &trans     &trans         &trans     &trans     &trans     &trans     &trans     &trans
    //╰──────────┴──────────┴──────────┴──────────┼──────────┼──────────┤   ├──────────┼──────────┼──────────┴──────────┴──────────┴──────────╯
                                           &trans     &lt LEF BSPC &kp SPACE     &kp ENTER  &lt RIG ESC &trans
    //                                 ╰──────────┴──────────┴──────────╯   ╰──────────┴──────────┴──────────╯
        >;
    };
