    right_layer {
        display-name = "^ Upper ^";
        bindings = <
    //╭──────────┬──────────┬──────────┬──────────┬──────────┬──────────╮   ╭──────────┬──────────┬──────────┬──────────┬──────────┬──────────╮
    //│          │  *       │  1       │  2       │  3       │  +       │   │          │  HOME    │  UP      │  END     │  PAGE UP │          │
        &trans    &kp LS(RBKT) &kp EXCL   &kp AT     &kp HASH   &kp LS(FSLH)   &none      &kp HOME   &kp UARW   &kp END    &kp PG_UP  &trans
    //├──────────┼──────────┼──────────┼──────────┼──────────┼──────────┤   ├──────────┼──────────┼──────────┼──────────┼──────────┼──────────┤
    //│          │  /       │  4       │  5       │  6       │  -       │   │          │ LEFT     │ DOWN     │ RIGHT    │  PAGE DN            │
        &trans     &kp LS(DOT) &kp DLLR   &kp PRCNT  &kp CARET  &kp EQUAL      &none     &kp LARW   &kp DARW   &kp RARW    &kp PG_DN  &trans
    //├──────────┼──────────┼──────────┼──────────┼──────────┼──────────┤   ├──────────┼──────────┼──────────┼──────────┼──────────┼──────────┤
    //│          │  .       │  7       │  8       │  9       │  0       │   │          │          │  MENU    │          │          │          │
        &trans    &kp LS(COMMA) &kp AMPS  &kp ASTRK  &kp LPAR   &kp RPAR       &none      &none     &kp K_APP   &none      &none      &trans
    //╰──────────┴──────────┴──────────┴──────────┼──────────┼──────────┤   ├──────────┼──────────┼──────────┴──────────┴──────────┴──────────╯
                                          &trans     &trans     &trans         &trans     &trans     &trans
    //                                 ╰──────────┴──────────┴──────────╯   ╰──────────┴──────────┴──────────╯
        >;
    };
